## boards/shields/reach56/Kconfig.defconfig
```kconfig
if SHIELD_REACH56_LEFT

# Name must be less than 16 characters long!
config ZMK_KEYBOARD_NAME
    default "Reach56"

config ZMK_SPLIT_ROLE_CENTRAL
    default y

endif

if SHIELD_REACH56_LEFT || SHIELD_REACH56_RIGHT

config ZMK_SPLIT
    default y

endif
```

## boards/shields/reach56/Kconfig.shield
```kconfig
config SHIELD_REACH56_LEFT
    def_bool $(shields_list_contains,reach56_left)

config SHIELD_REACH56_RIGHT
    def_bool $(shields_list_contains,reach56_right)
```
